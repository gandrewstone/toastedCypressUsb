;;*****************************************************************************
;;*****************************************************************************
;;  FILENAME: USBFS.inc
;;  Version: 1.80, Updated on 2011/9/2 at 9:40:44
;;  Generated by PSoC Designer 5.1.2309
;;
;;  DESCRIPTION:    Assembler declarations for the USB user module interface
;;-----------------------------------------------------------------------------
;;  Copyright (c) Cypress Semiconductor 2011. All Rights Reserved.
;;*****************************************************************************
;;*****************************************************************************

;--------------------------------------------------
; Constants for USBFS API's.
;--------------------------------------------------
USBFS_bNumStringDescrs: EQU    0x2

USB_NUM_ENDPOINTS:                          EQU 9 
USB_MAX_EP_NUMBER:                          EQU (USB_NUM_ENDPOINTS - 1) 

USB_3V_OPERATION:                            EQU 0x02
USB_5V_OPERATION:                            EQU 0x03

USB_MISC_ENABLE_SIE:                         EQU 0x07

;--------------------------------------------------
; Constants for interrupt regs and masks
;--------------------------------------------------
USBFS_INT_REG1:                            equ 0xDF
USBFS_INT_RESET_MASK:                      equ 0x04
USBFS_INT_SOF_MASK:                        equ 0x08
USBFS_INT_EP0_MASK:                        equ 0x10
USBFS_INT_EP1_MASK:                        equ 0x20
USBFS_INT_EP2_MASK:                        equ 0x40
USBFS_INT_EP3_MASK:                        equ 0x80

USBFS_INT_REG2:                            equ 0xDE
USBFS_INT_EP4_MASK:                        equ 0x01
USBFS_INT_EP5_MASK:                        equ 0x02
USBFS_INT_EP6_MASK:                        equ 0x04
USBFS_INT_EP7_MASK:                        equ 0x08
USBFS_INT_EP8_MASK:                        equ 0x10
USBFS_INT_WAKEUP_MASK:                     equ 0x20

;--------------------------------------------------
; Registers for USBFS API's.
;--------------------------------------------------

USBFS_ADDR:                                 EQU 0x33
USBFS_USBIO_CR0:                            EQU 0x34
USBFS_USBIO_CR1:                            EQU 0x35
USBFS_USB_CR1:                              EQU 0x30 

USBFS_EP0MODE:                              EQU 0x36
USBFS_EP0CNT:                               EQU 0x37
USBFS_EP0DATA:                              EQU 0x38
USBFS_EP1MODE:                              EQU 0x54
USBFS_EP1CNT0:                              EQU 0x40
USBFS_EP1CNT1:                              EQU 0x41
USBFS_EP2MODE:                              EQU 0x55
USBFS_EP2CNT0:                              EQU 0x42
USBFS_EP2CNT1:                              EQU 0x43
USBFS_EP3MODE:                              EQU 0x56
USBFS_EP3CNT0:                              EQU 0x44
USBFS_EP3CNT1:                              EQU 0x45
USBFS_EP4MODE:                              EQU 0x57
USBFS_EP4CNT0:                              EQU 0x46
USBFS_EP4CNT1:                              EQU 0x47

USBFS_EP5MODE:                              EQU 0x58
USBFS_EP5CNT0:                              EQU 0x48
USBFS_EP5CNT1:                              EQU 0x49

USBFS_EP6MODE:                              EQU 0x59
USBFS_EP6CNT0:                              EQU 0x4a
USBFS_EP6CNT1:                              EQU 0x4b

USBFS_EP7MODE:                              EQU 0x5a
USBFS_EP7CNT0:                              EQU 0x4c
USBFS_EP7CNT1:                              EQU 0x4d

USBFS_EP8MODE:                              EQU 0x5b
USBFS_EP8CNT0:                              EQU 0x4e
USBFS_EP8CNT1:                              EQU 0x4f

USBFS_USB_MISC_CR:                          EQU 0xbd

;--------------------------------------------------
; Endpoint 0 offsets (Table 9-2)
;--------------------------------------------------
bmRequestType:                              EQU 0
bRequest:                                   EQU 1
wValue:                                     EQU 2
wValueHi:                                   EQU 3
wValueLo:                                   EQU 2
wIndex:                                     EQU 4
wIndexHi:                                   EQU 5
wIndexLo:                                   EQU 4
wLength:                                    EQU 6
wLengthHi:                                  EQU 7
wLengthLo:                                  EQU 6

;--------------------------------------------------
; Request Types (Table 9-4)
;--------------------------------------------------
USB_GET_STATUS:                             EQU    0x00
USB_CLEAR_FEATURE:                          EQU    0x01
USB_SET_FEATURE:                            EQU    0x03
USB_SET_ADDRESS:                            EQU    0x05
USB_GET_DESCRIPTOR:                         EQU    0x06
USB_SET_DESCRIPTOR:                         EQU    0x07
USB_GET_CONFIGURATION:                      EQU    0x08
USB_SET_CONFIGURATION:                      EQU    0x09
USB_GET_INTERFACE:                          EQU    0x0A
USB_SET_INTERFACE:                          EQU    0x0B
USB_SYNCH_FRAME:                            EQU    0x0C

;--------------------------------------------------
; Descriptor Types (Table 9-5)
;--------------------------------------------------
DESCR_TYPE_DEVICE:                          EQU     1
DESCR_TYPE_CONFIG:                          EQU     2
DESCR_TYPE_STRING:                          EQU     3
DESCR_TYPE_INTERFACE:                       EQU     4
DESCR_TYPE_ENDPOINT:                        EQU     5
DESCR_TYPE_DEVICE_QUALIFIER:                EQU     6
DESCR_TYPE_OTHER_SPEED:                     EQU     7
DESCR_TYPE_INTERFACE_POWER:                 EQU     8

;--------------------------------------------------
; Feature Selectors (Table 9-6)
;--------------------------------------------------
USB_DEVICE_REMOTE_WAKEUP:                   EQU    0x01
USB_ENDPOINT_HALT:                          EQU    0x00
USB_TEST_MODE:                              EQU    0x02

;--------------------------------------------------
; USB Device Status (Figure 9-4)
;--------------------------------------------------
USB_DEVICE_STATUS_BUS_POWERED:              EQU   0x00
USB_DEVICE_STATUS_SELF_POWERED:             EQU   0x01
USB_DEVICE_STATUS_REMOTE_WAKEUP:            EQU   0x02

;--------------------------------------------------
; USB Endpoint Status (Figure 9-4)
;--------------------------------------------------
USB_ENDPOINT_STATUS_HALT:                   EQU    0x01

;--------------------------------------------------
; USB Endpoint Directions
;--------------------------------------------------
USB_DIR_IN:                                 EQU    0x80
USB_DIR_OUT:                                EQU    0x00
USB_DIR_UNUSED:                             EQU    0x7F

;--------------------------------------------------
; USB Endpoint Address Symbols 
;--------------------------------------------------
EP0:                                        EQU    0x00
EP1:                                        EQU    0x01
EP2:                                        EQU    0x02
EP3:                                        EQU    0x03
EP4:                                        EQU    0x04
EP5:                                        EQU    0x05
EP6:                                        EQU    0x06
EP7:                                        EQU    0x07
EP8:                                        EQU    0x08

;--------------------------------------------------
; Control Endpoint States--These act as JACC jump values
;--------------------------------------------------
USB_TRANS_STATE_IDLE:                       EQU     0x00         ;
USB_TRANS_STATE_CONTROL_READ:               EQU     0x02         ;
USB_TRANS_STATE_CONTROL_WRITE:              EQU     0x04         ;
USB_TRANS_STATE_NO_DATA_CONTROL:            EQU     0x06         ;

;--------------------------------------------------
; Control Write flag values to indicate pending data changes
;--------------------------------------------------
USB_ADDRESS_CHANGE_PENDING:     EQU     0x01

;--------------------------------------------------
; Register Constants for USBFS
;--------------------------------------------------
USB_ADDR_ENABLE: 			                         EQU    0x80
USB_CNT_VALID: 				                          EQU    0x40
USB_CNT_TOGGLE: 			                          EQU    0x80
USB_PULLUP_ENABLE:			                        EQU    0x04
USB_AUTO_DPDM: 				                          EQU    0x00
USB_REG_ENABLE: 			                          EQU    0x03
USB_PASS_THRU: 				                          EQU    0x02
USB_BUS_ACTIVITY: 			                        EQU    0x04

USB_MODE_DISABLE:                            EQU 0x00
USB_MODE_NAK_IN_OUT:                         EQU 0x01
USB_MODE_STATUS_OUT_ONLY:                    EQU 0x02
USB_MODE_STALL_IN_OUT:                       EQU 0x03
USB_MODE_RESERVED_0100:                      EQU 0x04
USB_MODE_ISO_OUT:                            EQU 0x05
USB_MODE_STATUS_IN_ONLY:                     EQU 0x06
USB_MODE_ISO_IN:                             EQU 0x07
USB_MODE_NAK_OUT:                            EQU 0x08
USB_MODE_ACK_OUT:                            EQU 0x09
USB_MODE_RESERVED_1010:                      EQU 0x0A
USB_MODE_ACK_OUT_STATUS_IN:                  EQU 0x0B
USB_MODE_NAK_IN:                             EQU 0x0C
USB_MODE_ACK_IN:                             EQU 0x0D
USB_MODE_RESERVED_1110:                      EQU 0x0E
USB_MODE_ACK_IN_STATUS_OUT:                  EQU 0x0F
USB_MODE_STALL_DATA_EP:                      EQU 0x80

;--------------------------------------------------
; LoadInEP Count Toggle (Argument values)
;--------------------------------------------------
USB_NO_TOGGLE:                               EQU 0x00
USB_TOGGLE:                                  EQU 0x01

;--------------------------------------------------
; FORCE J/K/SE0 (Argument values)
;--------------------------------------------------
USB_FORCE_J:                                 EQU 0xA0
USB_FORCE_K:                                 EQU 0x80
USB_FORCE_SE0:                               EQU 0xC0
USB_FORCE_NONE:                              EQU 0x00
USB_FORCE_STATE:                             EQU 0x01

;-----------------------------------------------
; Endpoint event flags
;-----------------------------------------------
NO_EVENT_ALLOWED:	equ               2
EVENT_PENDING:      equ               1
NO_EVENT_PENDING:   equ               0

IN_BUFFER_FULL:     equ               NO_EVENT_PENDING
IN_BUFFER_EMPTY:    equ               EVENT_PENDING
OUT_BUFFER_FULL:    equ               EVENT_PENDING
OUT_BUFFER_EMPTY:   equ               NO_EVENT_PENDING

;--------------------------------------------------
; USB Request Dispatch Functions, including overrides
;--------------------------------------------------
USB_NOT_SUPPORTED:  EQU 0x01
USB_UM_SUPPLIED:    EQU 0x02
USB_APP_SUPPLIED:   EQU 0x04

;--------------------------------------------------
; Device to host (d2h) Standard (std) Device (dev)
;--------------------------------------------------
USB_CB_SRC_d2h_std_dev_00: EQU USB_UM_SUPPLIED
USB_CB_SRC_d2h_std_dev_01: EQU USB_NOT_SUPPORTED
USB_CB_SRC_d2h_std_dev_02: EQU USB_NOT_SUPPORTED
USB_CB_SRC_d2h_std_dev_03: EQU USB_NOT_SUPPORTED
USB_CB_SRC_d2h_std_dev_04: EQU USB_NOT_SUPPORTED
USB_CB_SRC_d2h_std_dev_05: EQU USB_NOT_SUPPORTED
USB_CB_SRC_d2h_std_dev_06: EQU USB_UM_SUPPLIED
USB_CB_SRC_d2h_std_dev_07: EQU USB_NOT_SUPPORTED
USB_CB_SRC_d2h_std_dev_08: EQU USB_UM_SUPPLIED

;--------------------------------------------------
; Host to device (h2d) Standard (std) Device (dev)
;--------------------------------------------------
USB_CB_SRC_h2d_std_dev_00: EQU USB_NOT_SUPPORTED
USB_CB_SRC_h2d_std_dev_01: EQU USB_UM_SUPPLIED
USB_CB_SRC_h2d_std_dev_02: EQU USB_NOT_SUPPORTED
USB_CB_SRC_h2d_std_dev_03: EQU USB_UM_SUPPLIED
USB_CB_SRC_h2d_std_dev_04: EQU USB_NOT_SUPPORTED
USB_CB_SRC_h2d_std_dev_05: EQU USB_UM_SUPPLIED
USB_CB_SRC_h2d_std_dev_06: EQU USB_NOT_SUPPORTED
USB_CB_SRC_h2d_std_dev_07: EQU USB_NOT_SUPPORTED
USB_CB_SRC_h2d_std_dev_08: EQU USB_NOT_SUPPORTED
USB_CB_SRC_h2d_std_dev_09: EQU USB_UM_SUPPLIED

;--------------------------------------------------
; Device to host (d2h) Standard (std) Interface (ifc)
;--------------------------------------------------
USB_CB_SRC_d2h_std_ifc_00: EQU USB_UM_SUPPLIED
USB_CB_SRC_d2h_std_ifc_01: EQU USB_NOT_SUPPORTED
USB_CB_SRC_d2h_std_ifc_02: EQU USB_NOT_SUPPORTED
USB_CB_SRC_d2h_std_ifc_03: EQU USB_NOT_SUPPORTED
USB_CB_SRC_d2h_std_ifc_04: EQU USB_NOT_SUPPORTED
USB_CB_SRC_d2h_std_ifc_05: EQU USB_NOT_SUPPORTED
USB_CB_SRC_d2h_std_ifc_06: EQU USB_NOT_SUPPORTED
USB_CB_SRC_d2h_std_ifc_07: EQU USB_NOT_SUPPORTED
USB_CB_SRC_d2h_std_ifc_08: EQU USB_NOT_SUPPORTED
USB_CB_SRC_d2h_std_ifc_09: EQU USB_NOT_SUPPORTED
USB_CB_SRC_d2h_std_ifc_10: EQU USB_UM_SUPPLIED

;--------------------------------------------------
; Host to device (h2d) Standard (std) Interface (ifc)
;--------------------------------------------------
USB_CB_SRC_h2d_std_ifc_00: equ USB_NOT_SUPPORTED
USB_CB_SRC_h2d_std_ifc_01: equ USB_NOT_SUPPORTED
USB_CB_SRC_h2d_std_ifc_02: equ USB_NOT_SUPPORTED
USB_CB_SRC_h2d_std_ifc_03: equ USB_NOT_SUPPORTED
USB_CB_SRC_h2d_std_ifc_04: equ USB_NOT_SUPPORTED
USB_CB_SRC_h2d_std_ifc_05: equ USB_NOT_SUPPORTED
USB_CB_SRC_h2d_std_ifc_06: equ USB_NOT_SUPPORTED
USB_CB_SRC_h2d_std_ifc_07: equ USB_NOT_SUPPORTED
USB_CB_SRC_h2d_std_ifc_08: equ USB_NOT_SUPPORTED
USB_CB_SRC_h2d_std_ifc_09: equ USB_NOT_SUPPORTED
USB_CB_SRC_h2d_std_ifc_10: equ USB_NOT_SUPPORTED
USB_CB_SRC_h2d_std_ifc_11: equ USB_NOT_SUPPORTED

;--------------------------------------------------
; Device to host (d2h) Standard (std) Endpoint (ep)
;--------------------------------------------------
USB_CB_SRC_d2h_std_ep_00: equ USB_UM_SUPPLIED
USB_CB_SRC_d2h_std_ep_01: equ USB_NOT_SUPPORTED
USB_CB_SRC_d2h_std_ep_02: equ USB_NOT_SUPPORTED
USB_CB_SRC_d2h_std_ep_03: equ USB_NOT_SUPPORTED
USB_CB_SRC_d2h_std_ep_04: equ USB_NOT_SUPPORTED
USB_CB_SRC_d2h_std_ep_05: equ USB_NOT_SUPPORTED
USB_CB_SRC_d2h_std_ep_06: equ USB_NOT_SUPPORTED
USB_CB_SRC_d2h_std_ep_07: equ USB_NOT_SUPPORTED
USB_CB_SRC_d2h_std_ep_08: equ USB_NOT_SUPPORTED
USB_CB_SRC_d2h_std_ep_09: equ USB_NOT_SUPPORTED
USB_CB_SRC_d2h_std_ep_10: equ USB_NOT_SUPPORTED
USB_CB_SRC_d2h_std_ep_11: equ USB_NOT_SUPPORTED
USB_CB_SRC_d2h_std_ep_12: equ USB_NOT_SUPPORTED

;--------------------------------------------------
; Host to device (h2d) Standard (std) Endpoint (ep)
;--------------------------------------------------
USB_CB_SRC_h2d_std_ep_00: EQU USB_NOT_SUPPORTED
USB_CB_SRC_h2d_std_ep_01: EQU USB_UM_SUPPLIED
USB_CB_SRC_h2d_std_ep_02: EQU USB_NOT_SUPPORTED
USB_CB_SRC_h2d_std_ep_03: EQU USB_UM_SUPPLIED

;-----------------------------------------------
; 1st Tier Dispatch--Standard Requests
;-----------------------------------------------
USB_CB_h2d_std_dev: EQU 1
USB_CB_h2d_std_ifc: EQU 1
USB_CB_h2d_std_ep:  EQU 1
USB_CB_h2d_std_oth: EQU 0
USB_CB_d2h_std_dev: EQU 1
USB_CB_d2h_std_ifc: EQU 1
USB_CB_d2h_std_ep:  EQU 1
USB_CB_d2h_std_oth: EQU 0

;-----------------------------------------------
; 1st Tier Dispatch--Class Requests
;-----------------------------------------------
USB_CB_h2d_cls_dev: EQU 0
USB_CB_h2d_cls_ifc: EQU 0
USB_CB_h2d_cls_ep:  EQU 0
USB_CB_h2d_cls_oth: EQU 0
USB_CB_d2h_cls_dev: EQU 0
USB_CB_d2h_cls_ifc: EQU 0
USB_CB_d2h_cls_ep:  EQU 0
USB_CB_d2h_cls_oth: EQU 0

;-----------------------------------------------
; 1st Tier Dispatch--Vendor Specific Requests
;-----------------------------------------------
USB_CB_h2d_vnd_dev: EQU 0
USB_CB_h2d_vnd_ifc: EQU 0
USB_CB_h2d_vnd_ep:  EQU 0
USB_CB_h2d_vnd_oth: EQU 0
USB_CB_d2h_vnd_dev: EQU 0
USB_CB_d2h_vnd_ifc: EQU 0
USB_CB_d2h_vnd_ep:  EQU 0
USB_CB_d2h_vnd_oth: EQU 0

;-----------------------------------------------
; 1st Tier Dispatch--Reserved Requests
;-----------------------------------------------
USB_CB_h2d_rsv_dev: EQU 0
USB_CB_h2d_rsv_ifc: EQU 0
USB_CB_h2d_rsv_ep:  EQU 0
USB_CB_h2d_rsv_oth: EQU 0
USB_CB_d2h_rsv_dev: EQU 0
USB_CB_d2h_rsv_ifc: EQU 0
USB_CB_d2h_rsv_ep:  EQU 0
USB_CB_d2h_rsv_oth: EQU 0

;--------------------------------------------------
; Transfer Descriptor--Data Source
;--------------------------------------------------
USB_DS_ROM:                                      EQU 0x00
USB_DS_RAM:                                      EQU 0x01
USB_DS_RAM_CB:                                   EQU 0x02
USB_DS_RAM_MASK:                                 EQU 0x03

;-----------------------------------------------
; Transfer Completion Notification
;-----------------------------------------------
USB_XFER_IDLE:         EQU      0x00
USB_XFER_STATUS_ACK:   EQU      0x01
USB_XFER_PREMATURE:    EQU      0x02
USB_XFER_ERROR:        EQU      0x03

; This macro is used to allocate a completion status block
; for all Requests.  The macro parameter is used
; to prefix the two data elements.
USB_XFER_STATUS:       EQU      0
USB_XFER_LENGTH:       EQU      1
MACRO    USB_XFER_STATUS_BLOCK
    BLK    1    ; Completion Status
    BLK    2    ; Transfer Length
ENDM

;-----------------------------------------------
; USB Classes
;-----------------------------------------------
USB_CLASS_NONE:                        EQU    0x00
USB_CLASS_HID:                         EQU    0x01
USBFS_CLASS:                           EQU    USB_CLASS_NONE

;-----------------------------------------------
; Modify the supported requests by redefining
; them within the custom code area below
;-----------------------------------------------

   ;@PSoC_UserCode_BODY_1@ (Do not change this line.)
   ;---------------------------------------------------
   ; Insert your custom code below this banner
   ;---------------------------------------------------
   ;   NOTE: interrupt service routines must preserve
   ;   the values of the A and X CPU registers.
;-----------------------------------------------
; 1st Tier Dispatch--Class Requests
;-----------------------------------------------
USB_CB_h2d_cls_dev: EQU 0
USB_CB_h2d_cls_ifc: EQU 1
USB_CB_h2d_cls_ep:  EQU 0
USB_CB_h2d_cls_oth: EQU 0
USB_CB_d2h_cls_dev: EQU 0
USB_CB_d2h_cls_ifc: EQU 1
USB_CB_d2h_cls_ep:  EQU 0
USB_CB_d2h_cls_oth: EQU 0


   ;---------------------------------------------------
   ; Insert your custom code above this banner
   ;---------------------------------------------------
   ;@PSoC_UserCode_END@ (Do not change this line.)

;-----------------------------------------------
; Has the user enabled any of the Vendor Specific Requests
;-----------------------------------------------
USBFS_VSR_SUPPORT: EQU 0
IF USB_CB_h2d_vnd_dev
USBFS_VSR_SUPPORT: EQU 1
ENDIF
IF USB_CB_h2d_vnd_ifc
USBFS_VSR_SUPPORT: EQU 1
ENDIF
IF USB_CB_h2d_vnd_ep
USBFS_VSR_SUPPORT: EQU 1
ENDIF
IF USB_CB_h2d_vnd_oth
USBFS_VSR_SUPPORT: EQU 1
ENDIF
IF USB_CB_d2h_vnd_dev
USBFS_VSR_SUPPORT: EQU 1
ENDIF
IF USB_CB_d2h_vnd_ifc
USBFS_VSR_SUPPORT: EQU 1
ENDIF
IF USB_CB_d2h_vnd_ep
USBFS_VSR_SUPPORT: EQU 1
ENDIF
IF USB_CB_d2h_vnd_oth
USBFS_VSR_SUPPORT: EQU 1
ENDIF

; end of file USBFS.inc
