;;*****************************************************************************
;;*****************************************************************************
;;  FILENAME: Timer16.inc
;;   Version: 1.1, Updated on 2011/9/2 at 9:36:55
;;  Generated by PSoC Designer 5.1.2309
;;
;;  DESCRIPTION: Assembler declarations for the Timer16 user module interface
;;-----------------------------------------------------------------------------
;;  Copyright (c) Cypress Semiconductor 2011. All Rights Reserved.
;;*****************************************************************************
;;*****************************************************************************

include "m8c.inc"


;--------------------------------------------------
; Constants for Timer16 API's.
;--------------------------------------------------

Timer16_INT_REG:                           equ 0x0e0
Timer16_INT_MASK:                          equ 0x08
Timer16_INT_CLR_REG:                       equ 0xda
Timer16_INT_CLR_MASK:                      equ 0x8


;--------------------------------------------------
; @INSTANCE_NAME Default Parameters set in the Device Editor
;--------------------------------------------------

Timer16_PERIOD:                            equ 0x1
Timer16_MODE:                              equ 0x0
Timer16_CLOCK_SELECT:                      equ 0x1


;--------------------------------------------------
; Register Address Constants for Timer16
;--------------------------------------------------

Timer16_CONFIG_REG:                    equ 0xb0   ; Control register
Timer16_DATA1_REG:                     equ 0xb1   ; Function register
Timer16_DATA0_REG:                     equ 0xb2   ; Input register


; end of file Timer16.inc
