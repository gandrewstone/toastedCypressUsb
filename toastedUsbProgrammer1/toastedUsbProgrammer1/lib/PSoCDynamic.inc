;  Generated by PSoC Designer 5.1.2309
;
;
;  toastedusbprogrammer1Dynamic.inc
;
;  Data: 29 October, 2001
;  Copyright (c) Cypress Semiconductor 2011. All Rights Reserved.
;
;  This file is generated by the Device Editor on Application Generation.
;  It contains equates that are used to refer to the active configuration
;  status variable.
;  
;  DO NOT EDIT THIS FILE MANUALLY, AS IT IS OVERWRITTEN!!!
;  Edits to this file will not be preserved.
;
toastedUsbProgrammer1_BIT:	equ	 1h
toastedUsbProgrammer1_ORD:	equ	 0
toastedUsbProgrammer1_ADDR_OFF:	equ	 0
serialPassThru_BIT:	equ	 2h
serialPassThru_ORD:	equ	 1
serialPassThru_ADDR_OFF:	equ	 0
