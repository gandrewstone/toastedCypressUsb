; Generated by PSoC Designer 5.0.1127.0
;
;
;  PSoCGPIOINT.inc
;
;  Data: 29 October, 2001
;  Copyright (c) Cypress Semiconductor 2009. All Rights Reserved.
;
;  This file is generated by the Device Editor on Application Generation.
;  It contains equates that are useful in writing code relating to GPIO
;  related interrupts.
;  
;  DO NOT EDIT THIS FILE MANUALLY, AS IT IS OVERWRITTEN!!!
;  Edits to this file will not be preserved.
;
; Port_2_3 address and mask equates
Port_2_3_Data_ADDR:	equ	8h
Port_2_3_DriveMode_0_ADDR:	equ	108h
Port_2_3_DriveMode_1_ADDR:	equ	109h
Port_2_3_IntEn_ADDR:	equ	9h
Port_2_3_MASK:	equ	8h
Port_2_3_MUXBusCtrl_ADDR:	equ	1dah
; Port_1_7 address and mask equates
Port_1_7_Data_ADDR:	equ	4h
Port_1_7_DriveMode_0_ADDR:	equ	104h
Port_1_7_DriveMode_1_ADDR:	equ	105h
Port_1_7_IntEn_ADDR:	equ	5h
Port_1_7_MASK:	equ	80h
Port_1_7_MUXBusCtrl_ADDR:	equ	1d9h
; Port_1_7_Data access macros
;   GetPort_1_7_Data macro, return in a
macro GetPort_1_7_Data
	mov		a,[Port_1_Data_SHADE]
	and		a, 80h
endm
;   SetPort_1_7_Data macro
macro SetPort_1_7_Data
	or		[Port_1_Data_SHADE], 80h
	mov		a, [Port_1_Data_SHADE]
	mov		reg[Port_1_7_Data_ADDR], a
endm
;   ClearPort_1_7_Data macro
macro ClearPort_1_7_Data
	and		[Port_1_Data_SHADE], ~80h
	mov		a, [Port_1_Data_SHADE]
	mov		reg[Port_1_7_Data_ADDR], a
endm

; SPIMMISO address and mask equates
SPIMMISO_Data_ADDR:	equ	4h
SPIMMISO_DriveMode_0_ADDR:	equ	104h
SPIMMISO_DriveMode_1_ADDR:	equ	105h
SPIMMISO_IntEn_ADDR:	equ	5h
SPIMMISO_MASK:	equ	20h
SPIMMISO_MUXBusCtrl_ADDR:	equ	1d9h
; SPIMMISO_Data access macros
;   GetSPIMMISO_Data macro, return in a
macro GetSPIMMISO_Data
	mov		a,[Port_1_Data_SHADE]
	and		a, 20h
endm
;   SetSPIMMISO_Data macro
macro SetSPIMMISO_Data
	or		[Port_1_Data_SHADE], 20h
	mov		a, [Port_1_Data_SHADE]
	mov		reg[SPIMMISO_Data_ADDR], a
endm
;   ClearSPIMMISO_Data macro
macro ClearSPIMMISO_Data
	and		[Port_1_Data_SHADE], ~20h
	mov		a, [Port_1_Data_SHADE]
	mov		reg[SPIMMISO_Data_ADDR], a
endm

; SPIMMOSI address and mask equates
SPIMMOSI_Data_ADDR:	equ	4h
SPIMMOSI_DriveMode_0_ADDR:	equ	104h
SPIMMOSI_DriveMode_1_ADDR:	equ	105h
SPIMMOSI_IntEn_ADDR:	equ	5h
SPIMMOSI_MASK:	equ	2h
SPIMMOSI_MUXBusCtrl_ADDR:	equ	1d9h
; SPIMMOSI_Data access macros
;   GetSPIMMOSI_Data macro, return in a
macro GetSPIMMOSI_Data
	mov		a,[Port_1_Data_SHADE]
	and		a, 2h
endm
;   SetSPIMMOSI_Data macro
macro SetSPIMMOSI_Data
	or		[Port_1_Data_SHADE], 2h
	mov		a, [Port_1_Data_SHADE]
	mov		reg[SPIMMOSI_Data_ADDR], a
endm
;   ClearSPIMMOSI_Data macro
macro ClearSPIMMOSI_Data
	and		[Port_1_Data_SHADE], ~2h
	mov		a, [Port_1_Data_SHADE]
	mov		reg[SPIMMOSI_Data_ADDR], a
endm

; SPIMSCLK address and mask equates
SPIMSCLK_Data_ADDR:	equ	4h
SPIMSCLK_DriveMode_0_ADDR:	equ	104h
SPIMSCLK_DriveMode_1_ADDR:	equ	105h
SPIMSCLK_IntEn_ADDR:	equ	5h
SPIMSCLK_MASK:	equ	1h
SPIMSCLK_MUXBusCtrl_ADDR:	equ	1d9h
; SPIMSCLK_Data access macros
;   GetSPIMSCLK_Data macro, return in a
macro GetSPIMSCLK_Data
	mov		a,[Port_1_Data_SHADE]
	and		a, 1h
endm
;   SetSPIMSCLK_Data macro
macro SetSPIMSCLK_Data
	or		[Port_1_Data_SHADE], 1h
	mov		a, [Port_1_Data_SHADE]
	mov		reg[SPIMSCLK_Data_ADDR], a
endm
;   ClearSPIMSCLK_Data macro
macro ClearSPIMSCLK_Data
	and		[Port_1_Data_SHADE], ~1h
	mov		a, [Port_1_Data_SHADE]
	mov		reg[SPIMSCLK_Data_ADDR], a
endm

; Port_1_4 address and mask equates
Port_1_4_Data_ADDR:	equ	4h
Port_1_4_DriveMode_0_ADDR:	equ	104h
Port_1_4_DriveMode_1_ADDR:	equ	105h
Port_1_4_IntEn_ADDR:	equ	5h
Port_1_4_MASK:	equ	10h
Port_1_4_MUXBusCtrl_ADDR:	equ	1d9h
; Port_1_4_Data access macros
;   GetPort_1_4_Data macro, return in a
macro GetPort_1_4_Data
	mov		a,[Port_1_Data_SHADE]
	and		a, 10h
endm
;   SetPort_1_4_Data macro
macro SetPort_1_4_Data
	or		[Port_1_Data_SHADE], 10h
	mov		a, [Port_1_Data_SHADE]
	mov		reg[Port_1_4_Data_ADDR], a
endm
;   ClearPort_1_4_Data macro
macro ClearPort_1_4_Data
	and		[Port_1_Data_SHADE], ~10h
	mov		a, [Port_1_Data_SHADE]
	mov		reg[Port_1_4_Data_ADDR], a
endm

; Port_0_4 address and mask equates
Port_0_4_Data_ADDR:	equ	0h
Port_0_4_DriveMode_0_ADDR:	equ	100h
Port_0_4_DriveMode_1_ADDR:	equ	101h
Port_0_4_IntEn_ADDR:	equ	1h
Port_0_4_MASK:	equ	10h
Port_0_4_MUXBusCtrl_ADDR:	equ	1d8h
; Port_0_7 address and mask equates
Port_0_7_Data_ADDR:	equ	0h
Port_0_7_DriveMode_0_ADDR:	equ	100h
Port_0_7_DriveMode_1_ADDR:	equ	101h
Port_0_7_IntEn_ADDR:	equ	1h
Port_0_7_MASK:	equ	80h
Port_0_7_MUXBusCtrl_ADDR:	equ	1d8h
; Port_0_3 address and mask equates
Port_0_3_Data_ADDR:	equ	0h
Port_0_3_DriveMode_0_ADDR:	equ	100h
Port_0_3_DriveMode_1_ADDR:	equ	101h
Port_0_3_IntEn_ADDR:	equ	1h
Port_0_3_MASK:	equ	8h
Port_0_3_MUXBusCtrl_ADDR:	equ	1d8h
; Port_0_1 address and mask equates
Port_0_1_Data_ADDR:	equ	0h
Port_0_1_DriveMode_0_ADDR:	equ	100h
Port_0_1_DriveMode_1_ADDR:	equ	101h
Port_0_1_IntEn_ADDR:	equ	1h
Port_0_1_MASK:	equ	2h
Port_0_1_MUXBusCtrl_ADDR:	equ	1d8h
; Port_2_5 address and mask equates
Port_2_5_Data_ADDR:	equ	8h
Port_2_5_DriveMode_0_ADDR:	equ	108h
Port_2_5_DriveMode_1_ADDR:	equ	109h
Port_2_5_IntEn_ADDR:	equ	9h
Port_2_5_MASK:	equ	20h
Port_2_5_MUXBusCtrl_ADDR:	equ	1dah
; serialPassThruSPISSCLK address and mask equates
serialPassThruSPISSCLK_Data_ADDR:	equ	4h
serialPassThruSPISSCLK_DriveMode_0_ADDR:	equ	104h
serialPassThruSPISSCLK_DriveMode_1_ADDR:	equ	105h
serialPassThruSPISSCLK_IntEn_ADDR:	equ	5h
serialPassThruSPISSCLK_MASK:	equ	1h
serialPassThruSPISSCLK_MUXBusCtrl_ADDR:	equ	1d9h
; serialPassThruSPISSCLK_Data access macros
;   GetserialPassThruSPISSCLK_Data macro, return in a
macro GetserialPassThruSPISSCLK_Data
	mov		a,[Port_1_Data_SHADE]
	and		a, 1h
endm
;   SetserialPassThruSPISSCLK_Data macro
macro SetserialPassThruSPISSCLK_Data
	or		[Port_1_Data_SHADE], 1h
	mov		a, [Port_1_Data_SHADE]
	mov		reg[serialPassThruSPISSCLK_Data_ADDR], a
endm
;   ClearserialPassThruSPISSCLK_Data macro
macro ClearserialPassThruSPISSCLK_Data
	and		[Port_1_Data_SHADE], ~1h
	mov		a, [Port_1_Data_SHADE]
	mov		reg[serialPassThruSPISSCLK_Data_ADDR], a
endm

; serialPassThruSPISMOSI address and mask equates
serialPassThruSPISMOSI_Data_ADDR:	equ	4h
serialPassThruSPISMOSI_DriveMode_0_ADDR:	equ	104h
serialPassThruSPISMOSI_DriveMode_1_ADDR:	equ	105h
serialPassThruSPISMOSI_IntEn_ADDR:	equ	5h
serialPassThruSPISMOSI_MASK:	equ	2h
serialPassThruSPISMOSI_MUXBusCtrl_ADDR:	equ	1d9h
; serialPassThruSPISMOSI_Data access macros
;   GetserialPassThruSPISMOSI_Data macro, return in a
macro GetserialPassThruSPISMOSI_Data
	mov		a,[Port_1_Data_SHADE]
	and		a, 2h
endm
;   SetserialPassThruSPISMOSI_Data macro
macro SetserialPassThruSPISMOSI_Data
	or		[Port_1_Data_SHADE], 2h
	mov		a, [Port_1_Data_SHADE]
	mov		reg[serialPassThruSPISMOSI_Data_ADDR], a
endm
;   ClearserialPassThruSPISMOSI_Data macro
macro ClearserialPassThruSPISMOSI_Data
	and		[Port_1_Data_SHADE], ~2h
	mov		a, [Port_1_Data_SHADE]
	mov		reg[serialPassThruSPISMOSI_Data_ADDR], a
endm

; serialPassThruSPISMISO address and mask equates
serialPassThruSPISMISO_Data_ADDR:	equ	4h
serialPassThruSPISMISO_DriveMode_0_ADDR:	equ	104h
serialPassThruSPISMISO_DriveMode_1_ADDR:	equ	105h
serialPassThruSPISMISO_IntEn_ADDR:	equ	5h
serialPassThruSPISMISO_MASK:	equ	20h
serialPassThruSPISMISO_MUXBusCtrl_ADDR:	equ	1d9h
; serialPassThruSPISMISO_Data access macros
;   GetserialPassThruSPISMISO_Data macro, return in a
macro GetserialPassThruSPISMISO_Data
	mov		a,[Port_1_Data_SHADE]
	and		a, 20h
endm
;   SetserialPassThruSPISMISO_Data macro
macro SetserialPassThruSPISMISO_Data
	or		[Port_1_Data_SHADE], 20h
	mov		a, [Port_1_Data_SHADE]
	mov		reg[serialPassThruSPISMISO_Data_ADDR], a
endm
;   ClearserialPassThruSPISMISO_Data macro
macro ClearserialPassThruSPISMISO_Data
	and		[Port_1_Data_SHADE], ~20h
	mov		a, [Port_1_Data_SHADE]
	mov		reg[serialPassThruSPISMISO_Data_ADDR], a
endm

; serialPassThruSPISSS address and mask equates
serialPassThruSPISSS_Data_ADDR:	equ	4h
serialPassThruSPISSS_DriveMode_0_ADDR:	equ	104h
serialPassThruSPISSS_DriveMode_1_ADDR:	equ	105h
serialPassThruSPISSS_IntEn_ADDR:	equ	5h
serialPassThruSPISSS_MASK:	equ	80h
serialPassThruSPISSS_MUXBusCtrl_ADDR:	equ	1d9h
; serialPassThruSPISSS_Data access macros
;   GetserialPassThruSPISSS_Data macro, return in a
macro GetserialPassThruSPISSS_Data
	mov		a,[Port_1_Data_SHADE]
	and		a, 80h
endm
;   SetserialPassThruSPISSS_Data macro
macro SetserialPassThruSPISSS_Data
	or		[Port_1_Data_SHADE], 80h
	mov		a, [Port_1_Data_SHADE]
	mov		reg[serialPassThruSPISSS_Data_ADDR], a
endm
;   ClearserialPassThruSPISSS_Data macro
macro ClearserialPassThruSPISSS_Data
	and		[Port_1_Data_SHADE], ~80h
	mov		a, [Port_1_Data_SHADE]
	mov		reg[serialPassThruSPISSS_Data_ADDR], a
endm

