;;*****************************************************************************
;;*****************************************************************************
;;  FILENAME: SPIS.inc
;;   Version: 2.5, Updated on 2009/10/15 at 17:11:37
;;  Generated by PSoC Designer 5.0.1127.0
;;
;;  DESCRIPTION: Assembler declarations for the SPIS user module interface.
;;-----------------------------------------------------------------------------
;;  Copyright (c) Cypress Semiconductor 2009. All Rights Reserved.
;;*****************************************************************************
;;*****************************************************************************

include "m8c.inc"

;--------------------------------------------------
; Constants for SPIS API's.
;--------------------------------------------------
;mask value for global int reg bit for TX instance
SPIS_bINT_MASK:                        equ 20h
;SPIS interrupt address
SPIS_INT_REG:                          equ 0e0h
SPIS_SW_SS_Feature:                    equ  1

;-------------------------------
; SPI Configuration definitions
;-------------------------------
SPIS_SPI_MODE_0:             equ   00h      ;MODE 0 - Leading edge latches data - pos clock
SPIS_SPI_MODE_1:             equ   02h      ;MODE 1 - Leading edge latches data - neg clock
SPIS_SPI_MODE_2:             equ   04h      ;MODE 2 - Trailing edge latches data - pos clock
SPIS_SPI_MODE_3:             equ   06h      ;MODE 3 - Trailing edge latches data - neg clock
SPIS_SPI_LSB_FIRST:          equ   80h      ;LSB bit transmitted/received first
SPIS_SPI_MSB_FIRST:          equ   00h      ;MSB bit transmitted/received first
SPIS_SPI_SLAVE_SELECT:       equ   08h  ; SS Control bit

;---------------------------
; SPIS Status register masks
;---------------------------
SPIS_SPIS_RX_OVERRUN_ERROR:   equ   40h      ;Overrun error in received data
SPIS_SPIS_TX_BUFFER_EMPTY:    equ   10h      ;TX Buffer register is ready for next data byte
SPIS_SPIS_RX_BUFFER_FULL:     equ   08h      ;RX Buffer register has received current data
SPIS_SPIS_SPI_COMPLETE:       equ   20h      ;SPIS Tx/Rx cycle has completed

;--------------------------------------------------
; Register Address Constants for SPIS
;--------------------------------------------------
SPIS_CONFIG_REG:    equ 29h                      ;Control register
SPIS_CONTROL_REG:   equ 2bh                      ;Control register
SPIS_TX_BUFFER_REG: equ 29h                      ;TX Buffer Register
SPIS_RX_BUFFER_REG: equ 2ah                      ;RX Buffer Register

; end of file SPIS.inc
